ENTRY(_start)
PHDRS
{
  text PT_LOAD FLAGS(5) FILEHDR PHDRS;
  data PT_LOAD FLAGS(6);
}
SECTIONS
{
  . = 0x400000 + SIZEOF_HEADERS;
  .text : { *(.text*) *(.rodata*) } :text
  . = ALIGN(0x1000);
  .data : { *(.data*) } :data
  .bss : { *(.bss*) *(COMMON) } :data
  /DISCARD/ : { *(.comment) *(.eh_frame*) *(.note*) }
}
